## firmware/main/Kconfig.projbuild
```kconfig
# Definește opțiunile vizibile în `idf.py menuconfig` sub meniul "LifeAlertPlus Configuration".
# Valorile setate aici (sau direct în sdkconfig) sunt expuse în main.cpp ca macrouri CONFIG_* (vezi
# definițiile WIFI_SSID_DEFAULT, API_BASE_URL, API_DEVICE_SECRET de la începutul fișierului).
menu "LifeAlertPlus Configuration"

    config LIFEALERT_API_BASE_URL
        string "Backend API base URL"
        default "http://localhost:5176/"
        help
            URL-ul de bază al API-ului backend LifeAlertPlus. Include slash-ul final.
            Pentru build-urile de producție, pune aici URL-ul Azure (Web App), nu localhost.

    config LIFEALERT_API_DEVICE_SECRET
        string "ESP device shared secret (used to derive per-device X-Device-Key via HMAC-SHA256)"
        default ""
        help
            Secretul partajat folosit pentru a calcula cheia per-dispozitiv: HMAC-SHA256(secret, serial).
            Trebuie să fie identic cu valoarea Urls:EspDeviceSecret din appsettings-ul API-ului —
            altfel toate cererile dispozitivului vor fi respinse cu 401 (vezi ESPControllerTests.cs).
            Lasă gol în valorile comise în git; setează valoarea reală doar în sdkconfig-ul
            local (fișier ignorat de git, nu ajunge niciodată în repo).

    config LIFEALERT_DEFAULT_WIFI_SSID
        string "Fallback WiFi SSID"
        default ""
        help
            Rețeaua WiFi pe care dispozitivul o încearcă atunci când nu există nicio rețea
            salvată în NVS (prima pornire sau după un reset). Lasă gol pentru a omite complet
            acest fallback — în acest caz dispozitivul se poate conecta doar după ce utilizatorul
            configurează o rețea din interfața web (modul provisioning / SoftAP).

    config LIFEALERT_DEFAULT_WIFI_PASS
        string "Fallback WiFi password"
        default ""
        help
            Parola pentru rețeaua WiFi de rezervă de mai sus. Lasă gol pentru rețele deschise
            (fără parolă) sau când nu e configurat niciun SSID de rezervă.

endmenu
```

## firmware/sdkconfig.defaults
```kconfig
# Default project configuration committed to source control.
# Override in your local sdkconfig (gitignored) — do NOT put real secrets here.

CONFIG_PARTITION_TABLE_CUSTOM=y
CONFIG_PARTITION_TABLE_CUSTOM_FILENAME="partitions.csv"

CONFIG_LIFEALERT_API_BASE_URL="http://localhost:5176/"
CONFIG_LIFEALERT_API_DEVICE_SECRET="idontknowwhattoputhere"
CONFIG_LIFEALERT_DEFAULT_WIFI_SSID=""
CONFIG_LIFEALERT_DEFAULT_WIFI_PASS=""

# sys_evt stack: default 2304 bytes overflows when WiFi driver calls vfprintf internally.
# vfprintf_r alone needs 1072 bytes; 4096 gives enough headroom for the full dispatch chain.
CONFIG_ESP_SYSTEM_EVENT_TASK_STACK_SIZE=4096

# app_main stack: default 3584 bytes is too small for HTTPS (mbedTLS needs ~6-8KB).
# http_post_to calls esp_http_client_perform over TLS from main-loop context.
CONFIG_ESP_MAIN_TASK_STACK_SIZE=8192

# Task WDT timeout must exceed the HTTP client timeout (15s) plus worst-case queue flush.
# Default 5s fires during normal HTTPS operations and resets the board.
CONFIG_ESP_TASK_WDT_TIMEOUT_S=60
```
